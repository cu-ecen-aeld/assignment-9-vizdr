## base_external/Config.in
```kconfig
menu "Ass4 p2 Buildroot"
source "$BR2_EXTERNAL_project_base_PATH/package/eaesd-assignments/Config.in"
```

## base_external/package/aesd-assignments/Config.in
```kconfig
config BR2_PACKAGE_AESD_ASSIGNMENTS
	bool "aesd-assignment_5-p2"
	help
	  Includes the server in the kernel image.
	  Used to understand buildroot external trees and package builds.
	  Refers git repo assognment-3-and-later
```

## base_external/package/ldd/Config.in
```kconfig
config BR2_PACKAGE_LDD
	bool "ldd"
	help
	  Includes the server in the kernel image, misc-modules and driver from aesd ldd3.
	  Used to understand buildroot external trees and package builds.
	  Refers git repo assognment-3-and-later
```
